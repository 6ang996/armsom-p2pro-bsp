## buildroot/configs/rockchip_rk3308_bs_release_defconfig
```kconfig
#include "chips/rk3308_aarch64.config"
#include "base/base.config"
#include "audio.config"
#include "bt.config"
#include "network.config"
#include "test.config"
#include "vfat.config"
BR2_PACKAGE_COREUTILS=y
BR2_PACKAGE_EVTEST=y
BR2_PACKAGE_I2C_TOOLS=y
BR2_PACKAGE_IO=y
BR2_PACKAGE_IW=y
BR2_PACKAGE_STRACE=y
BR2_TARGET_GENERIC_HOSTNAME="rk3308_64"
BR2_TARGET_GENERIC_ISSUE="Welcome to RK3308 Buildroot"

# BR2_ROOTFS_OVERLAY="board/rockchip/rk3308/fs-overlay"
BR2_PACKAGE_WS281X=y
BR2_PACKAGE_TINYALSA=y
BR2_PACKAGE_MINICOM=y
```
